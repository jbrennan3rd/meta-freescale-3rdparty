## conf/machine/imx7d-skynff.conf
```bitbake
#@TYPE: Machine
#@NAME: SkyNFF
#@SOC: i.MX7D
#@DESCRIPTION: Machine configuration for i.MX7D SkyNFF board.
#@MAINTAINER: Jim Brennan <jim.brennan@igorinstitute.com>

MACHINEOVERRIDES =. "mx7:mx7d:"

require conf/machine/include/imx-base.inc
require conf/machine/include/tune-cortexa7.inc

MACHINE_FEATURES += " wifi bluetooth"

KERNEL_DEVICETREE = "imx7d-skylinenff.dtb imx7d-skylinenff-m4.dtb"

PREFERRED_PROVIDER_u-boot = "u-boot-imx7d-skynff"
#PREFERRED_PROVIDER_virtual/bootloader ?= "u-boot-imx7d-skynff"
PREFERRED_PROVIDER_virtual/kernel ?= "linux-skynff"


UBOOT_CONFIG ??= "sd"
UBOOT_CONFIG[sd] = "skynff_defconfig,sdcard"
```
